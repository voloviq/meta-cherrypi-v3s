## conf/machine/cherrypi-v3s-sdcard.conf
```bitbake
#@TYPE: Machine
#@NAME: Cherrypi V3s
#@DESCRIPTION: Machine configuration for the Cherrypi, based on Allwinner V3s CPU

require conf/machine/include/sun8i.inc

PREFERRED_PROVIDER_virtual/bootloader ?= "u-boot"
PREFERRED_PROVIDER_u-boot ?= "2024.01"
UBOOT_MACHINE ?= "sun8i-v3s-cherrypi_config"
SPL_BINARY ?= "u-boot-sunxi-with-spl.bin"
SUNXI_BOOT_SPACE ?= "40"

PREFERRED_PROVIDER_virtual/kernel ?= "linux-mainline"
PREFERRED_VERSION_linux-mainline ?= "6.6.28"
KERNEL_DEVICETREE_FILE = "sun8i-v3s-cherrypi.dtb"
KERNEL_DEVICETREE = "allwinner/${KERNEL_DEVICETREE_FILE}"
KERNEL_IMAGETYPE ?= "zImage"

IMAGE_BOOT_FILES ?= "\
    ${KERNEL_IMAGETYPE} \
    ${KERNEL_DEVICETREE_FILE} \
    ${SPL_BINARY} \
    boot.scr \
    "

MACHINE_ESSENTIAL_EXTRA_RRECOMMENDS = "kernel-modules"
MACHINE_ESSENTIAL_EXTRA_RDEPENDS = "kernel-image kernel-devicetree"
MACHINE_FEATURES ?= "alsa keyboard rtc serial screen usbgadget usbhost vfat"

SERIAL_CONSOLES = "115200;ttyS0"

WKS_FILE_DEPENDS ?= "virtual/kernel virtual/bootloader"
WKS_FILES ?= "sunxi-sdcard-image.wks.in"
IMAGE_CLASSES += "sdcard_image-sunxi"
IMAGE_FSTYPES += "tar.gz ext4 sunxi-sdimg wic wic.bmap"
```
