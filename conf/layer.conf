## conf/layer.conf
```bitbake
# We have a conf and classes directory, append to BBPATH
BBPATH .= ":${LAYERDIR}"

# We have a recipes directory, add to BBFILES
BBFILES += "${LAYERDIR}/recipes*/*/*.bb ${LAYERDIR}/recipes*/*/*.bbappend"

LAYERDEPENDS_meta-cherrypi-v3s = "core meta-python"
LAYERVERSION_meta-cherrypi-v3s = "1"

BBFILE_COLLECTIONS += "meta-cherrypi-v3s"
BBFILE_PATTERN_meta-cherrypi-v3s := "^${LAYERDIR}/"
BBFILE_PRIORITY_meta-cherrypi-v3s = "10"
LAYERSERIES_COMPAT_meta-cherrypi-v3s = "kirkstone"
```

## conf/machine/cherrypi-v3s-spinand.conf
```bitbake
#@TYPE: Machine
#@NAME: Cherrypi V3s
#@DESCRIPTION: Machine configuration for the Cherrypi, based on allwinner V3s CPU

require conf/machine/include/sun8i.inc

PREFERRED_PROVIDER_virtual/bootloader = "u-boot-spiflash"
PREFERRED_PROVIDER_u-boot-spiflash = "2020.01"
UBOOT_MACHINE = "cheerypi-v3s-spiflash_config"
SPL_BINARY ?= "u-boot-sunxi-with-spl.bin"
UBOOT_LOCALVERSION = "-g${@d.getVar('SRCPV', True).partition('+')[2][0:3]}"
UBOOT_ENTRYPOINT ?= "0x80008000"

PREFERRED_PROVIDER_virtual/kernel ?= "linux-suniv"
PREFERRED_VERSION_linux-suniv ?= "5.2"
KERNEL_DEVICETREE = "suniv-f1c100s-licheepi-nano-with-lcd.dtb"
KERNEL_IMAGETYPE ?= "uImage"

MACHINE_ESSENTIAL_EXTRA_RRECOMMENDS = " kernel-modules"
MACHINE_ESSENTIAL_EXTRA_RDEPENDS = "kernel-image kernel-devicetree"


# remove pulseaudio since it brings in x11
DISTRO_FEATURES_BACKFILL_CONSIDERED += "xcb wayland-egl xcomposite "

PREFERRED_PROVIDER_virtual/libgl ?= "sunxi-mali"
PREFERRED_PROVIDER_virtual/libgles1 ?= "sunxi-mali"
PREFERRED_PROVIDER_virtual/libgles2 ?= "sunxi-mali"
PREFERRED_PROVIDER_virtual/egl ?= "sunxi-mali"
PREFERRED_PROVIDER_virtual/mesa ?= "mesa"

PACKAGECONFIG_remove_pn-xserver-xorg = "glamor"
#IMAGE_FEATURES += "x11"
IMAGE_FEATURES += "hwcodecs"
DISTRO_FEATURES_append = " opengl x11 pulseaudio"
DISTRO_FEATURES_remove = "wayland"

PREFERRED_VERSION_tslib = "1.21"
PREFERRED_VERSION_gdb = "9.1"

SERIAL_CONSOLES = "115200;ttyS0"
```
